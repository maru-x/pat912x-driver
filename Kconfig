## Kconfig
```kconfig
config INPUT_PAT912X
	bool "PAT912X miniature optical navigation chip input driver"
	default n
	depends on DT_HAS_PIXART_PAT912X_ENABLED
	select I2C
	help
	  PAT912X miniature optical navigation chip input driver
```

## dts/bindings/input/pixart,pat912x.yaml
```yaml
# Copyright 2024 Google LLC
# SPDX-License-Identifier: Apache-2.0

description: PAT9125EL Miniature Optical Navigation Chip

compatible: "pixart,pat912x"

include: i2c-device.yaml

properties:
  motion-gpios:
    type: phandle-array
    required: true
    description: GPIO connected to the motion pin, active low.

  zephyr,axis-x:
    type: int
    description: |
      The input code for the X axis to report for the device, typically any of
      INPUT_REL_*. No report produced for the device X axis if unspecified.

  zephyr,axis-y:
    type: int
    description: |
      The input code for the Y axis to report for the device, typically any of
      INPUT_REL_*. No report produced for the device Y axis if unspecified.

  res-x-cpi:
    type: int
    description: |
      CPI resolution for the X axis, range 0 to 1275, rounded down to the
      closest supported value in increments of 5.

  res-y-cpi:
    type: int
    description: |
      CPI resolution for the Y axis, range 0 to 1275, rounded down to the
      closest supported value in increments of 5.

  invert-x:
    type: boolean
    description: |
      Invert X axis values.

  invert-y:
    type: boolean
    description: |
      Invert Y axis values.

  sleep1-enable:
    type: boolean
    description: |
      Enable sleep1 mode.

  sleep2-enable:
    type: boolean
    description: |
      Enable sleep2 mode, only valid if sleep1 is also enabled.

  sleep1-set-value:
    type: int
    default: 0x77
    description: |
      Value to set for sleep1 mode, range 0x00 to 0xFF.

  sleep2-set-value:
    type: int
    default: 0x10
    description: |
      Value to set for sleep2 mode, range 0x00 to 0xFF.

  mouse-wheel-x-inverted:
    type: boolean
    description: "Invert the X-axis movement of the mouse wheel."

  mouse-wheel-y-inverted:
    type: boolean
    description: "Invert the Y-axis movement of the mouse wheel."

  automouse-layer:
    type: int
    default: -1
    required: false
    description: Layer number to activate on mouse movement

  scroll-layer:
    type: int
    default: -1
    required: false
    description: Layer number to activate on scroll wheel movement

  snipe-layer:
    type: int
    default: -1
    required: false
    description: Layer number to activate on snipe button press

  scroll-ticks:
    type: int
    default: 50
    description: "Number of scroll wheel ticks to send per scroll wheel movement event."

  automouse_timeout_ms:
    type: int
    default: 5000
    description: "Time in milliseconds to wait before deactivating the automouse layer after no movement."

  snipe-ticks:
    type: int
    default: 5
    description: "Number of ticks to send when the snipe button is pressed."

  motion-timer-ms:
    type: int
    default: 20
    description: "Time in milliseconds to wait before checking for motion again."

  ny-min-value:
    type: int
    default: 1
    description: "Minimum value for the Y axis to be considered as motion."
```
